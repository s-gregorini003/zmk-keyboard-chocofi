&pro_micro_i2c {
    status = "okay";

    oled: sh1107@3c {
        compatible = "solomon,sh1107";
        reg = <0x3c>;
        segment-count = <64>;
        page-count = <16>;
        segment-offset = <0>;
        page-offset = <0>;
        display-offset = <0x60>;
        multiplex-ratio = <0x7f>;
        prechargep = <0x22>;
    };
};

/ {
    chosen {
        zephyr,display = &oled;
    };
};
