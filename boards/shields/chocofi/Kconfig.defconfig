## boards/shields/chocofi/Kconfig.defconfig
```kconfig
if SHIELD_CHOCOFI_LEFT

config ZMK_KEYBOARD_NAME
    default "Chocofi"

config ZMK_SPLIT_ROLE_CENTRAL
    default y

endif # SHIELD_CHOCOFI_LEFT

if SHIELD_CHOCOFI_LEFT || SHIELD_CHOCOFI_RIGHT

config ZMK_SPLIT
    default y

endif # SHIELD_CHOCOFI_LEFT || SHIELD_CHOCOFI_RIGHT

# Enable I2C for any build that includes a display add-on
if SHIELD_CHOCOFI_SSD1306 || SHIELD_CHOCOFI_SH1107

config I2C
    bool
    default y

endif # SHIELD_CHOCOFI_SSD1306 || SHIELD_CHOCOFI_SH1107

if SHIELD_CHOCOFI_SSD1306

if LVGL
config LV_Z_VDB_SIZE
    default 64

config LV_DPI_DEF
    default 148

config LV_Z_BITS_PER_PIXEL
    default 1

choice LV_COLOR_DEPTH
    default LV_COLOR_DEPTH_1
endchoice
endif # LVGL

endif # SHIELD_CHOCOFI_SSD1306

if SHIELD_CHOCOFI_SH1107

if LVGL
config LV_Z_VDB_SIZE
    default 32 

config LV_DPI_DEF
    default 128

config LV_Z_BITS_PER_PIXEL
    default 1

choice LV_COLOR_DEPTH
    default LV_COLOR_DEPTH_1
endchoice
endif # LVGL

endif # SHIELD_CHOCOFI_SH1107

if SHIELD_CHOCOFI_LEFT || SHIELD_CHOCOFI_RIGHT

if LVGL

config LV_Z_VDB_SIZE
    default 64

config LV_DPI_DEF
    default 148

config LV_Z_BITS_PER_PIXEL
    default 1

choice LV_COLOR_DEPTH
    default LV_COLOR_DEPTH_1
endchoice

endif # LVGL

endif # SHIELD_CHOCOFI_LEFT || SHIELD_CHOCOFI_RIGHT
```

## boards/shields/chocofi/Kconfig.shield
```kconfig
# Copyright (c) 2025 Silvio Gregorini
# SPDX-License-Identifier: MIT

config SHIELD_CHOCOFI_LEFT
    def_bool $(shields_list_contains,chocofi_left)

config SHIELD_CHOCOFI_RIGHT
    def_bool $(shields_list_contains,chocofi_right)

config SHIELD_CHOCOFI_SSD1306
    def_bool $(shields_list_contains,chocofi_ssd1306)

config SHIELD_CHOCOFI_SH1107
    def_bool $(shields_list_contains,chocofi_sh1107)
```
